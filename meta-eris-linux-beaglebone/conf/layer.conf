## meta-eris-linux-beaglebone/conf/layer.conf
```bitbake
# We have a conf and classes directory, add to BBPATH
BBPATH .= ":${LAYERDIR}"

# We have recipes-* directories, add to BBFILES
BBFILES += "${LAYERDIR}/recipes-*/*/*.bb \
            ${LAYERDIR}/recipes-*/*/*.bbappend"

BBFILE_COLLECTIONS += "meta-eris-linux-beaglebone"
BBFILE_PATTERN_meta-eris-linux-beaglebone = "^${LAYERDIR}/"
BBFILE_PRIORITY_meta-eris-linux-beaglebone = "85"

LAYERDEPENDS_meta-eris-linux-beaglebone = "core"
LAYERSERIES_COMPAT_meta-eris-linux-beaglebone = "kirkstone scarthgap"
```

## meta-eris-linux-beaglebone/wic/eris-linux-sdimage-beaglebone.wks
```
#
# Eris-Linux partitionning for BeagleBoneBlack sdcard.
#
part /boot --label boot       --ondisk mmcblk0 --fixed-size 32M --align 4096 --source bootimg-partition --fstype=vfat --active
part /     --label system-r   --ondisk mmcblk0 --size 512M      --align 4096 --source rootfs            --fstype=ext4
part       --label system-a   --ondisk mmcblk0 --size 512M      --align 4096 --source rootfs            --fstype=ext4
```

## meta-eris-linux-common/conf/layer.conf
```bitbake
# 'layer.conf'
#
# (C) 2024-2026 Logilin .
#

BBPATH .= ":${LAYERDIR}"

BBFILES += "${LAYERDIR}/recipes-*/*/*.bb \
            ${LAYERDIR}/recipes-*/*/*.bbappend"

BBFILE_COLLECTIONS += "meta-eris-linux-common"
BBFILE_PATTERN_meta-eris-linux-common = "^${LAYERDIR}/"
BBFILE_PRIORITY_meta-eris-linux-common = "80"

LAYERDEPENDS_meta-eris-linux-common = "core"
LAYERSERIES_COMPAT_meta-eris-linux-common = "kirkstone scarthgap"
```

## meta-eris-linux-qemu/conf/layer.conf
```bitbake
# We have a conf and classes directory, add to BBPATH
BBPATH .= ":${LAYERDIR}"

# We have recipes-* directories, add to BBFILES
BBFILES += "${LAYERDIR}/recipes-*/*/*.bb \
            ${LAYERDIR}/recipes-*/*/*.bbappend"

BBFILE_COLLECTIONS += "meta-eris-linux-qemu"
BBFILE_PATTERN_meta-eris-linux-qemu = "^${LAYERDIR}/"
BBFILE_PRIORITY_meta-eris-linux-qemu = "60"

LAYERDEPENDS_meta-eris-linux-qemu = "core"
LAYERSERIES_COMPAT_meta-eris-linux-qemu = "scarthgap"
```

## meta-eris-linux-raspberrypi/conf/layer.conf
```bitbake
# We have a conf and classes directory, add to BBPATH
BBPATH .= ":${LAYERDIR}"

# We have recipes-* directories, add to BBFILES
BBFILES += "${LAYERDIR}/recipes-*/*/*.bb \
            ${LAYERDIR}/recipes-*/*/*.bbappend"

BBFILE_COLLECTIONS += "meta-eris-linux-raspberrypi"
BBFILE_PATTERN_meta-eris-linux-raspberrypi = "^${LAYERDIR}/"
BBFILE_PRIORITY_meta-eris-linux-raspberrypi = "85"

LAYERDEPENDS_meta-eris-linux-raspberrypi = "core"
LAYERSERIES_COMPAT_meta-eris-linux-raspberrypi = "kirkstone scarthgap"
```

## meta-eris-linux/conf/distro/eris-linux-graphic-distro.conf
```bitbake
#
# `eris-linux-graphic-distro` configuration file.
#
# (c) 2025-2026 Logilin.
#
# Based on `poky/meta-poky/conf/distro/poky.conf`
#

require eris-linux-headless-distro.conf

DISTRO = "eris-linux-graphic-distro"
DISTRO_NAME = "Eris Linux Graphic Distro"

DISTRO_FEATURES += "opengl"
DISTRO_FEATURES += "eris-graphic"

IMAGE_BOOT_FILES += "eris-splashscreen-01.bmp"
IMAGE_BOOT_FILES += "eris-splashscreen-02.bmp"
```

## meta-eris-linux/conf/distro/eris-linux-headless-distro.conf
```bitbake
#
# `eris-linux-distro` configuration file.
#
# (c) 2025-2026 Logilin.
#
# Based on `poky/meta-poky/conf/distro/poky.conf`
#

DISTRO = "eris-linux-headless-distro"
DISTRO_NAME = "Eris Linux Headless Distro"
DISTRO_VERSION = "${ERIS_SYSTEM_VERSION}"
DISTRO_CODENAME = "cyrus"


DISTRO_EXTRA_RDEPENDS = ""
DISTRO_EXTRA_RRECOMMENDS = ""

# Keep only `eris-devel` if present.
DISTRO_FEATURES := "${@bb.utils.contains('DISTRO_FEATURES', 'eris-devel', 'eris-devel', '', d)}"

# Here are the standard Yocto DISTRO_FEATURES as described here : https://docs.yoctoproject.org/dev/singleindex.html#ref-features-distro
#
#    3g: Include support for cellular data.
#    acl: Include Access Control List support.
DISTRO_FEATURES += "acl"
#    alsa: Include Advanced Linux Sound Architecture support (OSS compatibility kernel modules installed if available).
#    api-documentation: Enables generation of API documentation during recipe builds. The resulting documentation is added to SDK tarballs when the bitbake -c populate_sdk command is used. See the “Adding API Documentation to the Standard SDK” section in the Yocto Project Application Development and the Extensible Software Development Kit (eSDK) manual.
#    bluetooth: Include bluetooth support (integrated BT only).
DISTRO_FEATURES += "bluetooth"
# 
#    cramfs: Include CramFS support.
#    debuginfod: Include support for getting ELF debugging information through a debuginfod server.
#    directfb: Include DirectFB support.
#    ext2: Include tools for supporting devices with internal HDD/Microdrive for storing files (instead of Flash only devices).
DISTRO_FEATURES += "ext2"
#    gobject-introspection-data: Include data to support GObject Introspection.
#    ipsec: Include IPSec support.
DISTRO_FEATURES += "ipsec"
#    ipv4: Include IPv4 support.
DISTRO_FEATURES += "ipv4"
#    ipv6: Include IPv6 support.
DISTRO_FEATURES += "ipv6"
#    keyboard: Include keyboard support (e.g. keymaps will be loaded during boot).
DISTRO_FEATURES +="keyboard"
#    minidebuginfo: Add minimal debug symbols (minidebuginfo) to binary files containing, allowing coredumpctl and gdb to show symbolicated stack traces.
#    multiarch: Enable building applications with multiple architecture support.
#    ld-is-gold: Use the gold linker instead of the standard GCC linker (bfd).
#    ldconfig: Include support for ldconfig and ld.so.conf on the target.
#    lto: Enable Link-Time Optimisation.
#    nfc: Include support for Near Field Communication.
#    nfs: Include NFS client support (for mounting NFS exports on device).
#    nls: Include National Language Support (NLS).
DISTRO_FEATURES += "nls"
#    opengl: Include the Open Graphics Library, which is a cross-language, multi-platform application programming interface used for rendering two and three-dimensional graphics.
#    overlayfs: Include OverlayFS support.
DISTRO_FEATURES += "overlayfs"
#    pam: Include Pluggable Authentication Module (PAM) support.
#    pci: Include PCI bus support.
#    pcmcia: Include PCMCIA/CompactFlash support.
#    pni-names: Enable generation of persistent network interface names, i.e. the system tries hard to have the same but unique names for the network interfaces even after a reinstall.
#    polkit: Include Polkit support.
#    ppp: Include PPP dialup support.
#    ptest: Enables building the package tests where supported by individual recipes. For more information on package tests, see the “Testing Packages With ptest” section in the Yocto Project Development Tasks Manual.
#    pulseaudio: Include support for PulseAudio.
#    selinux: Include support for Security-Enhanced Linux (SELinux) (requires meta-selinux).
#    seccomp: Enables building applications with seccomp support, to allow them to strictly restrict the system calls that they are allowed to invoke.
#    `seccomp` will be necessary to propose a Secure Boot Mode.
DISTRO_FEATURES += "seccomp"
#    smbfs: Include SMB networks client support (for mounting Samba/Microsoft Windows shares on device).
#    systemd: Include support for this init manager, which is a full replacement of for init with parallel starting of services, reduced shell overhead, and other features. This init manager is used by many distributions.
#    systemd-resolved: Include support and use systemd-resolved as the main DNS name resolver in glibc Name Service Switch. This is a DNS resolver daemon from systemd.
#    usbgadget: Include USB Gadget Device support (for USB networking/serial/storage).
#    usbhost: Include USB Host support (allows to connect external keyboard, mouse, storage, network etc).
DISTRO_FEATURES += "usbhost"
#    usrmerge: Merges the /bin, /sbin, /lib, and /lib64 directories into their respective counterparts in the /usr directory to provide better package and application compatibility.
#    vfat: Include FAT filesystem support.
DISTRO_FEATURES += "vfat"
#    vulkan: Include support for the Vulkan API.
DISTRO_FEATURES += "vulkan"
#    wayland: Include the Wayland display server protocol and the library that supports it.
#DISTRO_FEATURES += "wayland"
#    wifi: Include WiFi support (integrated only).
DISTRO_FEATURES += "wifi"
#    x11: Include the X server and libraries.
DISTRO_FEATURES += "x11"
#    xattr: Include support for extended file attributes.
#    zeroconf: Include support for zero configuration networking.

# Some more DISTRO_FEATURES.
#
DISTRO_FEATURES += "cgroup"


# `virtualization` is needed by Docker.
DISTRO_FEATURES += "virtualization"

# `sysvinit` instead of `systemd`
DISTRO_FEATURES += "sysvinit"
INIT_MANAGER ?= "sysvinit"

# Qemu-based target specific parameters
DISTRO_FEATURES += "${@bb.utils.contains('MACHINE', 'qemux86-64', 'no-update', '', d)}"
QB_KERNEL_CMDLINE_APPEND += 'init=/sbin/early-init'
QB_OPT_APPEND += "-drive file=data-partition.img,format=raw,if=virtio"


MAINTAINER = "Eris Linux Team <contact@eris-linux.net>"

SDK_VENDOR = "-eris"
TARGET_VENDOR = "-eris"

# ------------------------------------------------------------
LOCALCONF_VERSION = "2"

SDK_NAME = "eris-linux-sdk_${ERIS_SYSTEM_MODEL}_${ERIS_SYSTEM_TYPE}"
TOOLCHAIN_OUTPUTNAME = "${SDK_NAME}"
SDKPATHINSTALL = "/opt/${DISTRO}/${SDK_VERSION}"
INHERIT += "uninative"
require conf/distro/include/yocto-uninative.inc
require conf/distro/include/no-static-libs.inc
require conf/distro/include/security_flags.inc

TCLIBC = "musl"
TCLIBCAPPEND = ""
```
